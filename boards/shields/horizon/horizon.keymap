#include <behaviors.dtsi>
#include <dt-bindings/zmk/keys.h>
#include <dt-bindings/zmk/bt.h>
#include <dt-bindings/zmk/outputs.h>

#define l_ALPHA 0
#define l_CODE 1
#define l_HD 2
#define l_HD_CODE 3
#define l_L  4
#define l_R  5
#define l_B  6
#define l_G1 7
#define l_G2 8
#include "../globals.dtsi"

/{
    conditional_layers {
        compatible = "zmk,conditional-layers";
        tri_layer {
            if-layers = <l_L l_R>;
            then-layer = <l_B>;
        };
    };
    
    #include "horizon_layout.dtsi"
    #include "../behaviors.dtsi"    
    #include "../macros.dtsi"
    #include "../combos.dtsi"

    keymap {
        compatible = "zmk,keymap";
        #include "horizon_layers.dtsi"
    };
};