#define my_tapping_term 90
#define ak_idle_term 200
#define fnc_idle_term 400

#define TD_template compatible = "zmk,behavior-tap-dance"; #binding-cells = <0>;\
                                tapping-term-ms = <165>
#define ALPHAS A B C D E F G H I J H K L M N O P Q R S T U V W X Y Z
#define ALPHAS_S LS(A) LS(B) LS(C) LS(D) LS(E) LS(F) LS(G) LS(H) LS(I) LS(J) LS(H) LS(K) LS(L) LS(M) LS(N) LS(O) LS(P) LS(Q) LS(R) LS(S) LS(T) LS(U) LS(V) LS(W) LS(X) LS(Y) LS(Z)

#define CTRL_F_MACRO(key, f_key)  {compatible = "zmk,behavior-adaptive-key";#binding-cells = <0>;\
        bindings = <AS(key)>;\
        akt_ctrl { trigger-keys = <LCTRL>; max-prior-idle-ms = <fnc_idle_term>; bindings = <&kp f_key>; };\
    };
// #define     my_hrm_config \
//             compatible = "zmk,behavior-hold-tap"; \
//             #binding-cells = <2>; \
//             flavor = "balanced"; \
//             hold-trigger-on-release; \
//             tapping-term-ms = <my_tapping_term>; \
//             quick-tap-ms = <my_quick_tapping_term>

#define     my_lk_config \
            compatible = "zmk,behavior-hold-tap"; \
            #binding-cells = <2>; \
            tapping-term-ms = <my_tapping_term>; \
            flavor = "tap-preferred"

#define     ion_config \
            compatible = "zmk,behavior-hold-tap"; \
            #binding-cells = <2>; \
            tapping-term-ms = <145>; \
            flavor = "tap-preferred"

behaviors {

        mtg: mod_tap_game {
        compatible = "zmk,behavior-hold-tap";
        #binding-cells = <2>;
        flavor = "tap-preferred";
        tapping-term-ms = <400>;
        quick-tap-ms = <200>;
        global-quick-tap;
        bindings = <&kp>, <&kp>;
        hold-trigger-key-positions = <1>;    // <---[[the W key]]
    };

    as: auto_shift {
            compatible = "zmk,behavior-hold-tap";
            label = "AUTO_SHIFT";
            #binding-cells = <2>;
            tapping_term_ms = <170>;
            flavor = "tap-preferred";
            bindings = <&kp>, <&kp>; 
        };

    ss: shift_sticky {
            compatible = "zmk,behavior-hold-tap";
            label = "SHIFT_sticky";
            #binding-cells = <2>;
            tapping_term_ms = <160>;
            flavor = "tap-preferred";
            bindings = <&kp>, <&sk>; 
        };

    //
    // TAP DANCE
    //
    td_dot: td_dot {
        compatible = "zmk,behavior-tap-dance"; 
        #binding-cells = <0>;
        tapping-term-ms = <185>; 
        bindings = <&mt_dot 0 0>
                 , <AS(DOT)>
                 , <&dotdotdot>;
    };
    
    mt_dot: mt_dot {
            my_lk_config;
            bindings = <&colon_space>, <&dot_space_cap>;
        };
    
    td_comma: td_comma {
        TD_template;
        bindings = <&mt_comma 0 0>
                 , <AS(COMMA)>;
    };

    mt_comma: mt_comma {
            my_lk_config;
            bindings = <&semi_space>, <&comma_space>;
        };

        // CODE
    td_dot_code: td_dot_code {
        compatible = "zmk,behavior-tap-dance"; 
        #binding-cells = <0>;
        tapping-term-ms = <185>; 
        bindings = <&mt_dot_code LS(DOT) DOT>
                 , <&colon_space>;
    };

    mt_dot_code: mt_dot_code {
            my_lk_config;
            bindings = <&kp>, <&kp>;
        };
    
    td_comma_code: td_comma_code {
        TD_template;
        bindings = <&mt_comma_code LS(COMMA) 0>
                 // , <&mt_semi_code 0 COMMA >;
                    , <&semi_newline >;
    };

    mt_comma_code: mt_comma_code {
            my_lk_config;
            bindings = <&kp>, <&comma_space>;
        };
    
    // mt_semi_code: mt_semi_code {
    //         my_lk_config;
    //         bindings = <&semi_newline>, <&kp>;
        // };
        // CODE END

    td_qu: td_qu {
            TD_template;
            bindings = <&mt_qu 0 0>
                    , <AS(Q)>;
        };
    
    mt_qu: mt_qu {
            my_lk_config;
            bindings = <&macro_QU_cap>, <&macro_QU>;
        };
// ----- LAYER

    // Digraphs
    //
    lk_th: lk_th { // Th on tap, tion on "linger"
        ion_config;
        bindings = <&macro_tion>, <&macro_Th>;
    };
    lk_sh: lk_sh { // Sh on tap, sion on "linger"
        ion_config;
        bindings = <&macro_sion>, <&macro_Sh>;
    };
    lk_gh: lk_gh { // Gh on tap, Ght on "linger"
        ion_config;
        bindings = <&macro_ght>, <&macro_Gh>;
    };

// Adaptive Keys

    // M turns to L After X,W,G. 
    // G turns previous to L for M. MG->GL
    // G turns to L before and after K, GK->LK KG->KL
    // J expands G -> GTH,
    // H switches row for A,U,E,O
    // B and C -> BS, SB  B stands for S
    // B after P -> PS
    // C after T expands -> TCH
    // TK turns to C before K -> CK
    // U turns to I after Y (de)  


    ak_m: ak_m { // becomes L M->L: for G,X,W
        compatible = "zmk,behavior-adaptive-key";
        #binding-cells = <0>;
        bindings = <AS(M)>;

        akt_gm { trigger-keys = <G>; max-prior-idle-ms = <ak_idle_term>; bindings = <&kp L>; };
        akt_xm { trigger-keys = <X>; max-prior-idle-ms = <ak_idle_term>; bindings = <&kp BSPC &kp X &kp L>; };
        akt_wm { trigger-keys = <W>; max-prior-idle-ms = <ak_idle_term>; bindings = <&kp L>; };
    };

    ak_h: ak_h { // switches top and bottom row: A<-H->U,E<-H->O
        compatible = "zmk,behavior-adaptive-key";
        #binding-cells = <0>;
        bindings = <AS(H)>;

        akt_ah { trigger-keys = <A>; max-prior-idle-ms = <ak_idle_term>; bindings = <&kp U>; };
        akt_uh { trigger-keys = <U>; max-prior-idle-ms = <ak_idle_term>; bindings = <&kp A>; };
        akt_eh { trigger-keys = <E>; max-prior-idle-ms = <ak_idle_term>; bindings = <&kp O>; };
        akt_oh { trigger-keys = <O>; max-prior-idle-ms = <ak_idle_term>; bindings = <&kp E>; };
    };

    ak_b: ak_b { // raises to PB->PS. BC -> BS, CB->SB
        compatible = "zmk,behavior-adaptive-key";
        #binding-cells = <0>;
        bindings = <AS(B)>;

        akt_pb { trigger-keys = <P>; max-prior-idle-ms = <ak_idle_term>; bindings = <&kp S>; };
        akt_cb { trigger-keys = <C>; max-prior-idle-ms = <ak_idle_term>; bindings = <&kp BSPC &kp S &kp B>; };
    };

    ak_c: ak_c { // expands TC-> TCH, CB->SB (see above)
        compatible = "zmk,behavior-adaptive-key";
        #binding-cells = <0>;
        bindings = <AS(C)>;

        akt_tc { trigger-keys = <T>; max-prior-idle-ms = <ak_idle_term>; bindings = <&kp C &kp H>; };
        akt_bc { trigger-keys = <B>; max-prior-idle-ms = <ak_idle_term>; bindings = <&kp S>; };
    };

    ak_g: ak_g { // MG -> LG,  KG -> KL, JPG macro, 
        compatible = "zmk,behavior-adaptive-key";
        #binding-cells = <0>;
        bindings = <AS(G)>;

        akt_mg { trigger-keys = <M>; max-prior-idle-ms = <ak_idle_term>; bindings = <&kp BSPC &kp L &kp G>; };
        akt_kg { trigger-keys = <K>; max-prior-idle-ms = <ak_idle_term>; bindings = <&kp L>; };
        akt_jg { trigger-keys = <J>; max-prior-idle-ms = <ak_idle_term>; bindings = <&kp P &kp G>; }; //jpg
    };

    ak_j: ak_j { // expands GJ-> GTH, WJ->WL
        compatible = "zmk,behavior-adaptive-key";
        #binding-cells = <0>;
        bindings = <AS(J)>;

        akt_gj { trigger-keys = <G>; max-prior-idle-ms = <ak_idle_term>; bindings = <&kp T &kp H>; };
        akt_wj { trigger-keys = <W>; max-prior-idle-ms = <ak_idle_term>; bindings = <&kp L>; };
    };

    ak_k: ak_k { // GK->LK, TK->CK
        compatible = "zmk,behavior-adaptive-key";
        #binding-cells = <0>;
        bindings = <AS(K)>;

        akt_gk { trigger-keys = <G>; max-prior-idle-ms = <ak_idle_term>; bindings = <&kp BSPC &kp L &kp K>; };
        akt_tk { trigger-keys = <T>; max-prior-idle-ms = <ak_idle_term>; bindings = <&kp BSPC &kp C &kp K >; };
    };

    ak_u: ak_u {// YU-> YI
        compatible = "zmk,behavior-adaptive-key";
        #binding-cells = <0>;
        bindings = <AS(U)>;

        akt_yu { trigger-keys = <Z>; max-prior-idle-ms = <ak_idle_term>; bindings = <&kp I>; };
    };
    ak_x: ak_x { // GX->GT, MX->MB
        compatible = "zmk,behavior-adaptive-key";
        #binding-cells = <0>;
        bindings = <AS(X)>;

        akt_mx { trigger-keys = <M>; max-prior-idle-ms = <ak_idle_term>; bindings = <&kp B>; };
        akt_gx { trigger-keys = <G>; max-prior-idle-ms = <ak_idle_term>; bindings = <&kp T >; };
    };
    
    ak_apo: ak_apo { // apostrophe after Alpha
        compatible = "zmk,behavior-adaptive-key";
        #binding-cells = <0>;
        bindings = <AS(NON_US_HASH)>;

        akt_alpha {trigger-keys = <ALPHAS>; max-prior-idle-ms = <800>; bindings = <&kp LS(NON_US_HASH)>;};
        akt_bspc {trigger-keys = <BSPC>; max-prior-idle-ms = <300>; bindings = <&kp LS(NON_US_HASH)>;};
    };

    // Fkeys adaptive

    ak_col_x: ak_col_x CTRL_F_MACRO(C, F18)
    ak_hd_p: ak_hd_p CTRL_F_MACRO(P, F18)
    
    ak_col_c: ak_col_c CTRL_F_MACRO(C, F19)
    ak_hd_l: ak_hd_l CTRL_F_MACRO(C, F19)

    ak_all_w: ak_all_w CTRL_F_MACRO(W, F20)
    
    ak_all_d: ak_all_d CTRL_F_MACRO(D, F21)

    ak_all_v: ak_all_v CTRL_F_MACRO(V, F22)
// Right side
    ak_col_n: ak_col_n CTRL_F_MACRO(N, F23)
    ak_hd_a: ak_hd_a CTRL_F_MACRO(A, F23)

    ak_all_e: ak_all_e CTRL_F_MACRO(E, F24)
    
    ak_all_i: ak_all_i CTRL_F_MACRO(I, F17)


    // {
    //     compatible = "zmk,behavior-adaptive-key";
    //     #binding-cells = <0>;
    //     bindings = <AS(V)>;

    //     akt_ctrl { trigger-keys = <LCTRL>; max-prior-idle-ms = <fnc_idle_term>; bindings = <&kp LA(LC(F22))>; };
    // };

};
