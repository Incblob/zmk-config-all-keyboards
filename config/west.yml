## config/west.yml
```yaml
manifest:
  # defaults:
    # revision: v0.1 # version to use for this module and for ZMK
  remotes:
    - name: zmkfirmware
      url-base: https://github.com/zmkfirmware
    - name: urob
      url-base: https://github.com/urob
  projects:
    - name: zmk
      remote: urob #zmkfirmware #, see comment below
    revision: v0.2+fix-child-nodes #main
      import: app/west.yml
    - name: zmk-adaptive-key
      remote: urob
    revision: v0.2
  self:
    path: config
```
